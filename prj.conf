## CMakeLists.txt
```
#-------------------------------------------------------------------------------
# Zephyr Example Application
#
# Copyright (c) 2021 Nordic Semiconductor ASA
# SPDX-License-Identifier: Apache-2.0

cmake_minimum_required(VERSION 3.13.1)
find_package(Zephyr REQUIRED HINTS $ENV{ZEPHYR_BASE})

project(app LANGUAGES C)

target_include_directories(app PRIVATE include)

target_sources(app PRIVATE 
    src/main.c 
    src/imu_sim.c 
    src/ble_sim.c
    src/datalogger.c 
    src/flash_sim.c 
    src/hardware_sim.c
    )

# The code below locates the git index file for this repository and adds it as a dependency for
# the application VERSION file so that if the repo has a new commit added, even if no files in
# the build have changed, the application version file will be regenerated with the new git commit
find_package(Git QUIET)
if(GIT_FOUND)
  execute_process(
    COMMAND ${GIT_EXECUTABLE} rev-parse --absolute-git-dir
    WORKING_DIRECTORY .
    OUTPUT_VARIABLE application_git_dir
    OUTPUT_STRIP_TRAILING_WHITESPACE
    ERROR_STRIP_TRAILING_WHITESPACE
    ERROR_VARIABLE stderr
    RESULT_VARIABLE return_code
  )
  # If there is an error e.g. it is not a git repo, we just silently ignore it and continue
  # without a dependency, this will be the case with freestanding applications.
  if(NOT return_code)
    if(NOT "${stderr}" STREQUAL "")
      message(WARNING "Application build version git rev-parse warned: ${stderr}")
    endif()

    set_property(TARGET app_version_h PROPERTY APP_VERSION_DEPENDS ${application_git_dir}/index)
  endif()
endif()
```

## Kconfig
```
# Copyright (c) 2021 Nordic Semiconductor ASA
# SPDX-License-Identifier: Apache-2.0
#
# This file is the application Kconfig entry point. All application Kconfig
# options can be defined here or included via other application Kconfig files.
# You can browse these options using the west targets menuconfig (terminal) or
# guiconfig (GUI).

menu "Zephyr"
source "Kconfig.zephyr"
endmenu

module = APP
module-str = APP
source "subsys/logging/Kconfig.template.log_config"


config MAIN_SLEEP_MS
	int "Main Loop Sleep"
	default 100
```

## prj.conf
```kconfig
# Copyright (c) 2021 Nordic Semiconductor ASA
# SPDX-License-Identifier: Apache-2.0
#
# This file contains selected Kconfig options for the application.

CONFIG_SENSOR=y
CONFIG_THREAD_NAME=y
CONFIG_ZBUS=y
CONFIG_CRC=y

# Power Management simulation configurations
CONFIG_PM=y
CONFIG_PM_DEVICE=y


# Enable Emulated GPIO backend
CONFIG_GPIO=y
CONFIG_GPIO_GET_DIRECTION=y
CONFIG_GPIO_EMUL=y

CONFIG_ZBUS=y
CONFIG_ZBUS_MSG_SUBSCRIBER=y
CONFIG_ZBUS_MSG_SUBSCRIBER_NET_BUF_POOL_SIZE=16
CONFIG_ZBUS_MSG_SUBSCRIBER_NET_BUF_STATIC_DATA_SIZE=64
```

## boards/native_sim.overlay
```dts
/*
 * Copyright (c) 2021 Nordic Semiconductor ASA
 * SPDX-License-Identifier: Apache-2.0
 */

/ {
    aliases {
        sw0 = &wakeup_button;
    };

    buttons {
        compatible = "gpio-keys";
        wakeup_button: button_0 {
            /* Keep &gpio0 (the label) — it internally routes to gpio_emul */
            gpios = <&gpio0 5 (GPIO_ACTIVE_LOW | GPIO_PULL_UP)>;
            label = "Virtual Wakeup Button";
        };
    };
};
```

## src/main.c
```c
#include <zephyr/kernel.h>

#include "datalogger.h"
#include "ble_sim.h"
#include "flash_sim.h"
#include "imu_sim.h"
#include "hardware_sim.h"

#define APP_STACK_SIZE 1024
#define PRIO_DATALOGGER 4
#define PRIO_IMU 5
#define PRIO_BLE 6
#define PRIO_FLASH 6
#define PRIO_SIM 7

// Create thread stacks
static K_THREAD_STACK_DEFINE(datalogger_stack, APP_STACK_SIZE);
static K_THREAD_STACK_DEFINE(imu_stack, APP_STACK_SIZE);
static K_THREAD_STACK_DEFINE(ble_stack, APP_STACK_SIZE);
static K_THREAD_STACK_DEFINE(flash_stack, APP_STACK_SIZE);
static K_THREAD_STACK_DEFINE(sim_imu_stack, APP_STACK_SIZE);
static K_THREAD_STACK_DEFINE(sim_wakeup_stack, APP_STACK_SIZE);

static struct k_thread datalogger_thread_data;
static struct k_thread imu_thread_data;
static struct k_thread ble_thread_data;
static struct k_thread flash_thread_data;
static struct k_thread sim_imu_thread_data;
static struct k_thread sim_wakeup_thread_data;

// Create thread and name it
static void spawn(struct k_thread *thread, k_thread_stack_t *stack,
		  size_t stack_size, k_thread_entry_t entry, int priority,
		  const char *name)
{
	k_tid_t tid = k_thread_create(thread, stack, stack_size, entry,
				      NULL, NULL, NULL, priority, 0, K_NO_WAIT);

	k_thread_name_set(tid, name);
}

// Initialize peripherals and launch threads
int main(void)
{
	int ret;

	printk("*** Booting Zephyr OS on native_sim ***\n");

	// Check peirpherals can be initialized without errors
	ret = datalogger_init();
	if (ret < 0) {
		printk("datalogger_init failed (%d)\n", ret);
		return ret;
	}

	ret = sim_init();
	if (ret < 0) {
		printk("sim_init failed (%d)\n", ret);
		return ret;
	}

	ret = imu_init();
	if (ret < 0) {
		printk("imu_init failed (%d)\n", ret);
		return ret;
	}

	ret = flash_sim_init();
	if (ret < 0) {
		printk("flash_sim_init failed (%d)\n", ret);
		return ret;
	}

	// Create each thread for each peripheral
	spawn(&datalogger_thread_data, datalogger_stack,
	      K_THREAD_STACK_SIZEOF(datalogger_stack),
	      datalogger_thread, PRIO_DATALOGGER, "datalogger");
	spawn(&imu_thread_data, imu_stack, K_THREAD_STACK_SIZEOF(imu_stack),
	      imu_thread, PRIO_IMU, "imu");
	spawn(&ble_thread_data, ble_stack, K_THREAD_STACK_SIZEOF(ble_stack),
	      ble_thread, PRIO_BLE, "ble");
	spawn(&flash_thread_data, flash_stack, K_THREAD_STACK_SIZEOF(flash_stack),
	      flash_thread, PRIO_FLASH, "flash");
	spawn(&sim_imu_thread_data, sim_imu_stack,
	      K_THREAD_STACK_SIZEOF(sim_imu_stack),
	      sim_imu_thread, PRIO_SIM, "sim_imu");
	spawn(&sim_wakeup_thread_data, sim_wakeup_stack,
	      K_THREAD_STACK_SIZEOF(sim_wakeup_stack),
	      sim_wakeup_thread, PRIO_SIM, "sim_wakeup");

	return 0;
}
```

## include/ble_sim.h
```c
#pragma once

void ble_thread(void *p1, void *p2, void *p3);
```

## include/datalogger.h
```c
#pragma once

#include <stdbool.h>
#include <stdint.h>
#include <zephyr/zbus/zbus.h>
#include "imu_sim.h"

enum motion_msg_type {
	MOTION_MSG_WAKE,
	MOTION_MSG_MOTION_DETECTED,
	MOTION_MSG_NO_MOTION_DETECTED,
	MOTION_MSG_BATCH,
	MOTION_MSG_SLEEP,
};

struct motion_msg {
	enum motion_msg_type type;
	uint32_t timestamp_ms;
	bool motion;
	struct imu_data data;
};

ZBUS_CHAN_DECLARE(motion_zbus);

int datalogger_init(void);
void datalogger_thread(void *p1, void *p2, void *p3);
```

## include/flash_sim.h
```c
#pragma once

#include <stdint.h>
#include "imu_sim.h"

enum flash_event {
	FLASH_EVT_WAKEUP,
	FLASH_EVT_MOTION_DETECTED,
	FLASH_EVT_NO_MOTION_DETECTED,
	FLASH_EVT_SLEEP,
};

enum flash_record_type {
	FLASH_RECORD_EVENT,
	FLASH_RECORD_IMU,
};

struct flash_record {
	uint32_t timestamp_ms;
	enum flash_record_type type;
	enum flash_event event;
	struct imu_data data;
};

int flash_sim_init(void);
int flash_sim_append(const struct imu_data *data, uint32_t timestamp_ms);
int flash_sim_log_event(enum flash_event event, uint32_t timestamp_ms);
int flash_sim_read(uint16_t index, struct flash_record *record);
void flash_thread(void *p1, void *p2, void *p3);
```

## include/hardware_sim.h
```c
#pragma once

/* native_sim-only wakeup and sensor input. */
int sim_init(void);
void sim_wakeup_thread(void *p1, void *p2, void *p3);
void sim_imu_thread(void *p1, void *p2, void *p3);
```

## include/imu_sim.h
```c
#pragma once

#include <stdbool.h>
#include <stddef.h>
#include <stdint.h>
#include <zephyr/zbus/zbus.h>

#define IMU_BATCH_SIZE 10
#define IMU_FIFO_DEPTH (IMU_BATCH_SIZE * 2)

struct imu_sample {
	uint8_t accel_x;
	uint8_t accel_y;
	uint8_t accel_z;
};

struct imu_data {
	struct imu_sample samples[IMU_BATCH_SIZE];
	uint8_t count;
};

int imu_init(void);
int imu_start(void);
int imu_stop(void);
bool imu_is_started(void);
int imu_fifo_read(struct imu_sample *out, size_t max);

ZBUS_CHAN_DECLARE(imu_zbus);
void imu_thread(void *p1, void *p2, void *p3);

/* Called by the native_sim sensor stub. */
int imu_sim_push_sample(const struct imu_sample *sample);
```

## src/ble_sim.c
```c
#include <zephyr/kernel.h>
#include <zephyr/zbus/zbus.h>

#include "ble_sim.h"
#include "datalogger.h"
#include "flash_sim.h"

ZBUS_MSG_SUBSCRIBER_DEFINE(ble_sub);
ZBUS_CHAN_ADD_OBS(motion_zbus, ble_sub, 2);

// Handle the history payload
static void history_work_handler(struct k_work *work)
{
	struct flash_record rec;

	for (uint16_t i = 0; flash_sim_read(i, &rec) == 0; i++) {
		if (rec.type == FLASH_RECORD_IMU) {
			printk("[BLE][Offload] t=%u ms, %u samples\n",
			       rec.timestamp_ms, rec.data.count);
		} else {
			printk("[BLE][Offload] t=%u ms, event %d\n",
			       rec.timestamp_ms, rec.event);
		}
	}
	printk("[BLE][Offload] Complete\n");
}

K_WORK_DEFINE(history_work, history_work_handler);

// Callback for receiving payload request.
void rx_callback()
{
	// Submit worked to load read flash and send out data.
	k_work_submit(&history_work);

}

// Send samples out of BLE
void tx_samples(struct motion_msg msg)
{
	// Create and send out IMU data over BLE
	printk("[BLE] Streaming %u IMU samples\n", msg.data.count);

}
void ble_thread(void *p1, void *p2, void *p3)
{
	const struct zbus_channel *chan;

	// Wait for motion data zbus message
	while (1) {
		struct motion_msg msg;
		int err = zbus_sub_wait_msg(&ble_sub, &chan, &msg, K_FOREVER);

		if (err) {
			printk("[BLE] Message wait failed (%d)\n", err);
			continue;
		}

		// If not a Batch message, skip.  These are the Events for the Flash to log
		// Note: This could be handled by having a different queue or bus for the flash events
		//       but for this assessment I have re-used the same bus to save time.
		if (msg.type != MOTION_MSG_BATCH || !msg.motion) {
			continue;
		}

		if (msg.data.count > IMU_BATCH_SIZE) {
			msg.data.count = IMU_BATCH_SIZE;
		}

		/* Replace with the BLE notify/write call on hardware. */
		// Publish samples over BLE
		tx_samples(msg);
	}
}
```

## src/datalogger.c
```c
#include <errno.h>
#include <zephyr/kernel.h>
#include <zephyr/drivers/gpio.h>
#include <zephyr/zbus/zbus.h>

#include "datalogger.h"
#include "imu_sim.h"

#define BUTTON_NODE DT_ALIAS(sw0)
#define INACTIVITY_TIMEOUT K_MINUTES(5)
#define SIM_MOTION_BATCHES 10

static const struct gpio_dt_spec button = GPIO_DT_SPEC_GET(BUTTON_NODE, gpios);
static struct gpio_callback button_cb_data;
static K_SEM_DEFINE(wakeup_sem, 0, 1);
static K_SEM_DEFINE(inactivity_sem, 0, 1);
static uint32_t sim_batch_count;

ZBUS_MSG_SUBSCRIBER_DEFINE(logger_sub);
ZBUS_CHAN_ADD_OBS(imu_zbus, logger_sub, 1);

ZBUS_CHAN_DEFINE(
	motion_zbus,
	struct motion_msg,
	NULL,
	NULL,
	ZBUS_OBSERVERS_EMPTY,
	ZBUS_MSG_INIT(0)
);

static void inactivity_timer_callback(struct k_timer *timer)
{
	k_sem_give(&inactivity_sem);
}

K_TIMER_DEFINE(inactivity_timer, inactivity_timer_callback, NULL);

static void button_pressed_callback(const struct device *dev,
				    struct gpio_callback *cb, uint32_t pins)
{
	k_sem_give(&wakeup_sem);
}

// black box algorithim
static bool detect_motion(const struct imu_data *data)
{
	/* Replace with the assessment's black-box classifier. */
	return sim_batch_count++ < SIM_MOTION_BATCHES;
}

// Publish a message on the motion bus
static int publish_message(enum motion_msg_type type, bool motion,
			   const struct imu_data *data)
{
	struct motion_msg msg = {
		.type = type,
		.timestamp_ms = k_uptime_get_32(),
		.motion = motion,
	};

	if (data != NULL) {
		msg.data = *data;
	}

	return zbus_chan_pub(&motion_zbus, &msg, K_MSEC(100));
}

static void publish_event(enum motion_msg_type type)
{
	int err = publish_message(type, false, NULL);

	if (err) {
		printk("[Datalogger] Event publish failed (%d)\n", err);
	}
}

int datalogger_init(void)
{
	int ret;

	if (!gpio_is_ready_dt(&button)) {
		return -ENODEV;
	}

	ret = gpio_pin_configure_dt(&button, GPIO_INPUT);
	if (ret < 0) {
		return ret;
	}

	gpio_init_callback(&button_cb_data, button_pressed_callback,
			   BIT(button.pin));

	ret = gpio_add_callback(button.port, &button_cb_data);
	if (ret < 0) {
		return ret;
	}

	return gpio_pin_interrupt_configure_dt(&button, GPIO_INT_EDGE_FALLING);
}


static bool inactivity_timeout_reached(bool *inactivity_pending,
				       bool *have_motion_state,
				       bool *last_motion)
{

	if (k_sem_take(&inactivity_sem, K_NO_WAIT) != 0) {
		return false;
	}

	return *inactivity_pending;
}

static void run_active(void)
{
	bool inactivity_pending = false;
	bool have_motion_state = false;
	bool last_motion = false;
	const struct zbus_channel *chan;

	sim_batch_count = 0;
	k_timer_stop(&inactivity_timer);
	k_sem_reset(&inactivity_sem);

	if (imu_start() < 0) {
		printk("[Datalogger] Failed to start IMU\n");
		return;
	}

	while (1) {
		struct imu_data batch;
		int err = zbus_sub_wait_msg(&logger_sub, &chan, &batch, K_MSEC(50));
		if (err == 0) {
			bool motion;

			if (batch.count > IMU_BATCH_SIZE) {
				printk("[Datalogger] Invalid sample count %u; clamping\n",
				       batch.count);
				batch.count = IMU_BATCH_SIZE;
			}

			// Blackbox algorithim to determine motion
			motion = detect_motion(&batch);

			// Only log motion state transitions, not every batch's motion
			if (!have_motion_state || motion != last_motion) {
				publish_event(motion ? MOTION_MSG_MOTION_DETECTED :
						       MOTION_MSG_NO_MOTION_DETECTED);
				have_motion_state = true;
				last_motion = motion;
			}

			// Motion cancels the inactivity timer. The first no-motion
			// batch after motion starts it; later ones leave it running.
			if (motion) {
				// Stop and reset the inactivity status
				k_timer_stop(&inactivity_timer);
				k_sem_reset(&inactivity_sem); // Prevent race condition
				inactivity_pending = false;

				// Publish batch to BLE and Flash if motion is detected.
				err = publish_message(MOTION_MSG_BATCH, motion, &batch);
				if (err) {
					printk("[Datalogger] Batch publish failed (%d)\n", err);
				}
			} else if (!inactivity_pending) {
				k_sem_reset(&inactivity_sem); // Prevent race condition
				k_timer_start(&inactivity_timer, INACTIVITY_TIMEOUT,
					      K_NO_WAIT);
				inactivity_pending = true;
			}
		} else if (err != -ENOMSG && err != -EAGAIN) {
			printk("[Datalogger] IMU message wait failed (%d)\n", err);
		}

		if (inactivity_timeout_reached(&inactivity_pending,
					       &have_motion_state,
					       &last_motion)) {
			//Return and enter_sleep
			return;
		}
	}
}

static void enter_sleep(void)
{
	const struct zbus_channel *chan;
	struct imu_data stale;

	k_timer_stop(&inactivity_timer);
	imu_stop();
	publish_event(MOTION_MSG_SLEEP);

	while (zbus_sub_wait_msg(&logger_sub, &chan, &stale, K_NO_WAIT) == 0) {
	}

	k_sem_reset(&wakeup_sem);
}

void datalogger_thread(void *p1, void *p2, void *p3)
{

	while (1) {
		printk("[Datalogger] Sleeping; waiting for wakeup\n");
		k_sem_take(&wakeup_sem, K_FOREVER);

		printk("[Datalogger] Wakeup received\n");
		publish_event(MOTION_MSG_WAKE);
		run_active();
		enter_sleep();
	}
}
```

## src/flash_sim.c
```c
#include <errno.h>
#include <zephyr/kernel.h>
#include <zephyr/zbus/zbus.h>

#include "flash_sim.h"
#include "datalogger.h"

#define FLASH_RECORD_CAPACITY 256

static struct flash_record records[FLASH_RECORD_CAPACITY];
static uint16_t record_count;
K_MUTEX_DEFINE(records_mutex);

ZBUS_MSG_SUBSCRIBER_DEFINE(flash_sub);
ZBUS_CHAN_ADD_OBS(motion_zbus, flash_sub, 3);

// Convert Flash Event ENUM into Text String
static const char *event_name(enum flash_event event)
{
	switch (event) {
	case FLASH_EVT_WAKEUP:
		return "WAKEUP";
	case FLASH_EVT_MOTION_DETECTED:
		return "MOTION_DETECTED";
	case FLASH_EVT_NO_MOTION_DETECTED:
		return "NO_MOTION_DETECTED";
	case FLASH_EVT_SLEEP:
		return "SLEEP";
	default:
		return "UNKNOWN";
	}
}

int flash_sim_init(void)
{
	record_count = 0;
	return 0;
}

// Store record in flash
static int store_record(struct flash_record *record)
{
	int err = 0;

	k_mutex_lock(&records_mutex, K_FOREVER);
	if (record_count >= FLASH_RECORD_CAPACITY) {
		err = -ENOSPC;
	} else {
		records[record_count++] = *record;
	}
	k_mutex_unlock(&records_mutex);

	if (err) {
		printk("[Flash] Log full; record dropped\n");
	}
	return err;
}

// Simulate logging to flash
int flash_sim_log_event(enum flash_event event, uint32_t timestamp_ms)
{
	struct flash_record record = {
		.timestamp_ms = timestamp_ms,
		.type = FLASH_RECORD_EVENT,
		.event = event,
	};
	int err;

	if ((unsigned int)event > FLASH_EVT_SLEEP) {
		return -EINVAL;
	}

	err = store_record(&record);
	if (!err) {
		printk("[Flash][Event] %s\n", event_name(event));
	}

	return err;
}

int flash_sim_append(const struct imu_data *data, uint32_t timestamp_ms)
{
	struct flash_record record = {
		.timestamp_ms = timestamp_ms,
		.type = FLASH_RECORD_IMU,
	};

	if (data == NULL) {
		return -EINVAL;
	}

	record.data = *data;
	if (store_record(&record) == 0) {
		printk("[Flash][IMU] Stored batch (%u samples)\n", data->count);
		return 0;
	}

	return -ENOSPC;
}

int flash_sim_read(uint16_t index, struct flash_record *record)
{
	if (record == NULL) {
		return -EINVAL;
	}

	k_mutex_lock(&records_mutex, K_FOREVER);
	if (index >= record_count) {
		k_mutex_unlock(&records_mutex);
		return -ENOENT;
	}

	*record = records[index];
	k_mutex_unlock(&records_mutex);
	return 0;
}

void flash_thread(void *p1, void *p2, void *p3)
{
	const struct zbus_channel *chan;

	// Wait for motion data zbus message
	while (1) {
		struct motion_msg msg;
		int err = zbus_sub_wait_msg(&flash_sub, &chan, &msg, K_FOREVER);

		if (err) {
			printk("[Flash] Message wait failed (%d)\n", err);
			continue;
		}

		switch (msg.type) {
		case MOTION_MSG_WAKE:
			flash_sim_log_event(FLASH_EVT_WAKEUP,  msg.timestamp_ms);
			break;
		case MOTION_MSG_MOTION_DETECTED:
			flash_sim_log_event(FLASH_EVT_MOTION_DETECTED,  msg.timestamp_ms);
			break;
		case MOTION_MSG_NO_MOTION_DETECTED:
			flash_sim_log_event(FLASH_EVT_NO_MOTION_DETECTED,  msg.timestamp_ms);
			break;
		case MOTION_MSG_BATCH:
			if (msg.motion) {
				flash_sim_append(&msg.data,  msg.timestamp_ms);
			}
			break;
		case MOTION_MSG_SLEEP:
			flash_sim_log_event(FLASH_EVT_SLEEP,  msg.timestamp_ms);
			break;
		default:
			break;
		}
	}
}
```

## src/hardware_sim.c
```c
#include <zephyr/kernel.h>
#include <zephyr/drivers/gpio.h>
#include <zephyr/drivers/gpio/gpio_emul.h>

#include "hardware_sim.h"
#include "imu_sim.h"

#define BUTTON_NODE DT_ALIAS(sw0)
#define SIM_SAMPLE_PERIOD_MS 100

static const struct gpio_dt_spec button = GPIO_DT_SPEC_GET(BUTTON_NODE, gpios);

int sim_init(void)
{
	return gpio_emul_input_set(button.port, button.pin, 1);
}

void sim_wakeup_thread(void *p1, void *p2, void *p3)
{
	k_sleep(K_SECONDS(10));

	while (1) {
		printk("[SIM] Triggering wakeup\n");
		gpio_emul_input_set(button.port, button.pin, 0);
		k_sleep(K_MSEC(100));
		gpio_emul_input_set(button.port, button.pin, 1);
		k_sleep(K_MINUTES(6));
	}
}

void sim_imu_thread(void *p1, void *p2, void *p3)
{
	uint8_t next_x = 0;

	while (1) {
		struct imu_sample sample;

		k_sleep(K_MSEC(SIM_SAMPLE_PERIOD_MS));
		if (!imu_is_started()) {
			continue;
		}

		sample.accel_x = next_x++;
		sample.accel_y = 1;
		sample.accel_z = 2;

		if (imu_sim_push_sample(&sample) != 0) {
			printk("[SIM] IMU FIFO full; sample dropped\n");
		}
	}
}
```

## src/imu_sim.c
```c
#include <errno.h>
#include <zephyr/kernel.h>
#include <zephyr/zbus/zbus.h>

#include "imu_sim.h"

// Bus to forward IMU data to datalogger
ZBUS_CHAN_DEFINE(
	imu_zbus,
	struct imu_data,
	NULL,
	NULL,
	ZBUS_OBSERVERS_EMPTY,
	ZBUS_MSG_INIT(0)
);

// Simulate IMU fifo with a queue
K_MSGQ_DEFINE(imu_fifo, sizeof(struct imu_sample), IMU_FIFO_DEPTH, 1);

// Simulate watermark interrupt with a semaphore
static K_SEM_DEFINE(watermark_sem, 0, 1);
static atomic_t started;

static void watermark_interrupt(void)
{
	k_sem_give(&watermark_sem);
}

int imu_init(void)
{
	printk("[IMU] Initialized\n");
	return 0;
}

int imu_start(void)
{
	k_msgq_purge(&imu_fifo);
	k_sem_reset(&watermark_sem);
	atomic_set(&started, 1);
	printk("[IMU] Started\n");
	return 0;
}

int imu_stop(void)
{
	atomic_set(&started, 0);
	k_msgq_purge(&imu_fifo);
	k_sem_reset(&watermark_sem);
	printk("[IMU] Stopped\n");
	return 0;
}

bool imu_is_started(void)
{
	return atomic_get(&started) != 0;
}

int imu_fifo_read(struct imu_sample *out, size_t max)
{
	size_t count = 0;

	while (count < max &&
	       k_msgq_get(&imu_fifo, &out[count], K_NO_WAIT) == 0) {
		count++;
	}

	return count;
}

int imu_sim_push_sample(const struct imu_sample *sample)
{
	if (sample == NULL) {
		return -EINVAL;
	}

	if (k_msgq_put(&imu_fifo, sample, K_NO_WAIT) != 0) {
		return -ENOSPC;
	}

	if (k_msgq_num_used_get(&imu_fifo) >= IMU_BATCH_SIZE) {
		watermark_interrupt();
	}

	return 0;
}

void imu_thread(void *p1, void *p2, void *p3)
{
	while (1) {
		k_sem_take(&watermark_sem, K_FOREVER);

		while (k_msgq_num_used_get(&imu_fifo) >= IMU_BATCH_SIZE) {
			struct imu_data batch = {0};
			int count = imu_fifo_read(batch.samples, IMU_BATCH_SIZE);
			int err;

			if (count <= 0) {
				break;
			}

			batch.count = count;
			err = zbus_chan_pub(&imu_zbus, &batch, K_MSEC(100));
			if (err) {
				printk("[IMU] Batch publish failed (%d)\n", err);
			}
		}
	}
}
```
